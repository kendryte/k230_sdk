## Kconfig
```kconfig
mainmenu "K230 SDK Configuration"


source Kconfig.board
source Kconfig.toolchain
source Kconfig.memory
source Kconfig.storage
source Kconfig.wifi

config SUPPORT_RTSMART
        bool  "support rt smart on core 1"
        default y
        help  
                support rt smart on core 1;

config SUPPORT_LINUX
        bool  "support linux "
        default y
        help  
           support linux ;

config LINUX_RUN_CORE_ID
        depends on SUPPORT_LINUX
        int  "support linux on core id"
        default 0
        help  
           support linux  on core num;
           
####################debug /realse version begain {
choice 
	prompt "build debug/release version"
    default BUILD_RELEASE_VER
    help
        build debug/release version.

config BUILD_DEBUG_VER
	bool "debug"

config BUILD_RELEASE_VER
	bool "release"

endchoice


config DBGLV
        int  "config debug level"
        depends on BUILD_DEBUG_VER
        help  
              debug level: 0...8 ;
              0----release
        default 0 if BUILD_RELEASE_VER
        default 8 if BUILD_DEBUG_VER
####################debug /realse version end }
```

## Kconfig.board
```kconfig
menu "board configuration"

choice

	prompt "reference board"
        help
          Select the reference board.

config BOARD_K230_EVB
	bool "K230 evb"

config BOARD_K230_FPGA
	bool "K230 fpga"

config BOARD_K230D
	bool "K230 sip"
        help
           "siplp4 128MB ddr";

config BOARD_K230_CANMV
	bool "K230 CANMV(K230PI)"
        help
           "CANMV(K230PI)";

config BOARD_K230_CANMV_V2
	bool "K230 CANMV(K230PI) V2"
        help
           "CANMV(K230PI) V2";

config BOARD_K230D_CANMV
	bool "K230D CANMV(K230PI zero)"
        help
           "CANMV(K230D PI zero)";

config BOARD_K230_CANMV_01STUDIO
       bool "K230 CANMV(01STUDIO)"
        help
           "CANMV(01STUDIO)";

config BOARD_K230_CANMV_LCKFB
	bool "K230 CANMV LCKFB"
        help
           "CANMV LCKFB";

config BOARD_K230_CANMV_DONGSHANPI
       bool "K230 CANMV(DONGSHANPI)"
        help
           "CANMV(DONGSHANPI)";

config BOARD_K230_CANMV_RTT_EVB
       bool "K230 CANMV(rtt evb)"
        help
           "CANMV(rtt evb)";

config BOARD_K230D_CANMV_BPI
       bool "K230 CANMV(BPI)"
        help
           "CANMV(k230d bpi)";
endchoice


config BOARD_NAME
       string "define K230 reference board name"
       #depends on BOARD_K230_EVB=y || BOARD_K230_FPGA=y
       default "k230_evb"

config QUICK_BOOT
        bool "quick boot"
        help
              quick boot, not enter uboot cmd;
        default y

config GEN_SECURITY_IMG
        bool "create security image "
        help
              create security image ;
        default n

config UBOOT_DEFCONFIG
        string "uboot defconfig  "
        help
                uboot defconfig ;
        default BOARD_NAME

config LINUX_DEFCONFIG
        string "linux defconfig  "
        help
                linux defconfig ;
        default BOARD_NAME

config LINUX_DTB
        string "linux dtb name"
        help
                linux  dtb name ;
        default BOARD_NAME

config BUILDROOT_DEFCONFIG
        string "buildroot defconfig  "
        help
                buildroot defconfig ;
        default BOARD_NAME

config RTTHREAD_DEFCONFIG
        string "rtthread defconfig  "
        help
                rtthread defconfig ;

config REMOTE_TEST_PLATFORM
        bool "config REMOTE_TEST_PLATFORM"
        help
              xxxe ;
        default n
config GEN_IMG_SCRIPT
        string "generate image scripte"
        help
              generate image scripte;
       default "board/common/gen_image_script/gen_image.sh"
config RTT_CONSOLE_ID
        depends on SUPPORT_RTSMART
	int "RTT console id"
	default 3

config SPI_NOR_SUPPORT_CFG_PARAM
        bool "spi nor support cfg param"
        depends on  SPI_NOR
        help
              spi nor support cfg param ;
        default y

config CANAAN_SITE_IMG_NAME_PREFIX
        string "canaan site image name prefix"
        default ""
        help
                canaan site image name prefix;
endmenu
```

## Kconfig.memory
```kconfig
menu "Memory configuration"

config MEM_TOTAL_SIZE
	hex "total memory size"
	default 0x20000000

#MEM_PARAM_BASE
config MEM_QUICK_BOOT_CFG_BASE
	hex "quick boot cfg  memory address"
	default 0x00000000
config MEM_QUICK_BOOT_CFG_SIZE
	hex "quick boot cfg size"
	default 0x00040000

config MEM_SENSOR_CFG_BASE
	hex "sensor parameters memory address"
	default 0x00040000
config MEM_SENSOR_CFG_SIZE
	hex "sensor parameters memory size"
	default 0x000c0000


config MEM_IPCM_BASE
	hex "IPCM base memory address"
	default 0x00100000
config MEM_IPCM_SIZE
	hex "IPCM memory size"
	default 0x00100000

config MEM_RTT_SYS_BASE
	hex "rt-smart system base memory address"
	default 0x00200000
config MEM_RTT_SYS_SIZE
	hex "rt-smart system memory size"
	default 0x07e00000

config MEM_LINUX_SYS_BASE
	hex "linux system base memory address"
	default 0x08000000
config MEM_LINUX_SYS_SIZE
	hex "linux system memory size"
	default 0x08000000

config MEM_AI_MODEL_BASE
	hex "AI model memory address"
	default 0x10000000
config MEM_AI_MODEL_SIZE
	hex "AI model memory size"
	default 0x04000000

config MEM_FACE_DATA_BASE
	hex "face database address"
	default 0x14000000
config MEM_FACE_DATA_SIZE
	hex "face database size"
	default 0x00040000

config MEM_SPECKLE_BASE
	hex "speckle pattern address"
	default 0x14040000
config MEM_SPECKLE_SIZE
	hex "speckle pattern size"
	default 0x01000000

config MEM_MMZ_BASE
	hex "MMZ base memory address"
	default 0x18000000
config MEM_MMZ_SIZE
	hex "MMZ memory size"
	default 0x8000000

config MEM_RTAPP_BASE
	hex "rtapp memory address"
	default 0x18000000
config MEM_RTAPP_SIZE
	hex "rtapp memory size"
	default 0x8000000

config MEM_BOUNDARY_RESERVED_SIZE
	hex "reserved memory size, reserve 4K memory in each memeory boundary, to detect memory out of bounds access"
	default 0x00001000

endmenu
```

## Kconfig.storage
```kconfig
menu "storage configurations"
config SPI_NOR
        bool "enable spi nor flash"
        default y

#config SPI_NOR_CFG
#	string "chose spi nor genimage configuration"
#	depends on SPI_NOR=y

config SPI_NAND
        bool "enable spi nand flash"
        default n

#config SPI_NAND_CFG
#	string "chose spi nand genimage configuration"
#	depends on SPI_NAND=y

config SDCAED
        bool "enable sd card"
        default y

config SPI_SDCARD_CFG
	string "chose sd card genimage configuration"
	depends on SDCARED=y

#config EMMC
#        bool "enable EMMC"
#        default y

#config SPI_EMMC_CFG
#	string "chose EMMC genimage configuration"
#	depends on EMMC=y




menu  "spi nor partion config"
depends on SPI_NOR
        config SPI_NOR_RTTK_BASE
                hex "rtt kernel base "
                default 0x840000
        config SPI_NOR_RTTK_SIZE
                hex "rtt kernel size"
                default 0x1c0000
        


        config SPI_NOR_LK_BASE
                hex "linux kernel base "
                default 0xfc0000
        config SPI_NOR_LK_SIZE
                hex "linux kernel size"
                default 0x700000

        
        config SPI_NOR_LR_BASE
                hex "linux rootfs CFG base "
                default 0x16c0000
        config SPI_NOR_LR_SIZE
                hex "linux rootfs CFG size"
                default 0x900000
        menu  "spi nor cfg param partion config"
        depends on SPI_NOR_SUPPORT_CFG_PARAM
                #quick boot
                config SPI_NOR_QUICK_BOOT_CFG_BASE
                        hex "quick boot CFG base "
                        default 0x200000
                config SPI_NOR_QUICK_BOOT_CFG_SIZE
                        hex "quick boot CFG size"
                        default 0x80000
                config SPI_NOR_QUICK_BOOT_CFG_SUPPORT_BAKEUP
                        bool "support backup quick boot CFG "
                        default n
        

                #face database
                config SPI_NOR_FACE_DB_CFG_BASE
                        hex "face db  base "
                        default 0x280000
                config SPI_NOR_FACE_DB_CFG_SIZE
                        hex "face db size"
                        default 0x80000
                config SPI_NOR_FACE_DB_CFG_SUPPORT_BAKEUP
                        bool "support backup face db "
                        default n


                #sensor cfg
                config SPI_NOR_SENSOR_CFG_CFG_BASE
                        hex "sensor cfg CFG base "
                        default 0x300000
                config SPI_NOR_SENSOR_CFG_CFG_SIZE
                        hex "sensor cfg CFG size"
                        default 0x40000
        
                #ai mode         
                config SPI_NOR_AI_MODE_CFG_BASE
                        hex "ai mode CFG base "
                        default 0x340000
                config SPI_NOR_AI_MODE_CFG_SIZE
                        hex "ai mode CFG size"
                        default 0x300000



                #speckle
                config SPI_NOR_SPECKLE_CFG_BASE
                        hex "speckle CFG base "
                        default 0x640000
                config SPI_NOR_SPECKLE_CFG_SIZE
                        hex "speckle CFG size"
                        default 0x200000

                config SPI_NOR_RTT_APP_BASE
                        hex "rtt  app base "
                        default 0xa00000
                config SPI_NOR_RTT_APP_SIZE
                        hex "rtt  app size"
                        default 0x5c0000


        endmenu  #"spi nor cfg param partion config"

endmenu  #"spi nor partion config"
endmenu #"storage configurations"
```

## Kconfig.toolchain
```kconfig
menu "toolchain configurations"
config TOOLCHAIN_PREFIX_RTT
        string "rt-smart toolchain prefix"
        default "riscv64-unknown-linux-musl-"

config TOOLCHAIN_PATH_RTT
        string "rt-smart toolchain path"
        default "/opt/toolchain/riscv64-linux-musleabi_for_x86_64-pc-linux-gnu/bin"

config TOOLCHAIN_PREFIX_LINUX
        string "linux toolchain prefix"
        default "riscv64-unknown-linux-gnu-"

config TOOLCHAIN_PATH_LINUX
        string "linux toolchain path"
        default "/opt/toolchain/Xuantie-900-gcc-linux-5.10.4-glibc-x86_64-V2.6.0/bin"

endmenu
```

## Kconfig.wifi
```kconfig
menu "wifi configurations"
config AP6212A
        bool "enable ap6212a"
        default n

config AP6256
        bool "enable ap6256"
        default n

config RTL8188FU
        bool "enable rtl8188fu"
        default n
        
config RTL8723DU
        bool "enable rtl8723du"
        default n
endmenu
```

## src/big/rt-smart/kernel/bsp/maix3/Kconfig
```kconfig
mainmenu "RT-Thread Project Configuration"

config BSP_DIR
    string
    option env="BSP_ROOT"
    default "."

config RTT_DIR
    string
    option env="RTT_ROOT"
    default "../../rt-thread"

config PKGS_DIR
    string
    option env="PKGS_ROOT"
    default "packages"

source "$RTT_DIR/Kconfig"
source "$PKGS_DIR/Kconfig"
source "testcase/kernel/Kconfig"

config BOARD_fpgac908
    bool
    select ARCH_RISCV64
    select RT_USING_COMPONENTS_INIT
    select RT_USING_USER_MAIN
    select RT_USING_CACHE
	select ARCH_MM_MMU
    default y

config RT_USING_USERSPACE
    bool
    default y

config ENABLE_FPU
    bool "Enable FPU"
    default y

config ENABLE_VECTOR
    bool "Using RISC-V Vector Extension"
    default y

config __STACKSIZE__
    int "stack size for interrupt"
    default 4096
```

## src/big/rt-smart/kernel/bsp/maix3/testcase/kernel/Kconfig
```kconfig
menu "Kernel Testcase"

config UTEST_MEMHEAP_TC
    bool "memheap stability test"
    default y
    depends on RT_USING_MEMHEAP

config UTEST_IRQ_TC
    bool "IRQ test"
    default n

config UTEST_SEMAPHORE_TC
    bool "semaphore test"
    default n
    depends on RT_USING_SEMAPHORE

config UTEST_EVENT_TC
    bool "event test"
    default n
    depends on RT_USING_EVENT

config UTEST_TIMER_TC
    bool "timer test"
    default n

config UTEST_MESSAGEQUEUE_TC
    bool "message queue test"
    default n

config UTEST_MUTEX_TC
    bool "mutex test"
    default n

config UTEST_MAILBOX_TC
    bool "mailbox test"
    default n

config UTEST_THREAD_TC
    bool "thread test"
    default n
    select RT_USING_TIMER_SOFT
    select RT_USING_THREAD

config UTEST_MMU_TC
    bool "MMU test"
    default n

config UTEST_ADC
    bool "ADC test"
    default n

config RT_USING_GPIO
    bool "GPIO test"
    default n

config RT_USING_SPI
    bool "SPI test"
    default n

config UTEST_OTP
    bool "OTP test"
    default n

config UTEST_WDT
    bool "WatchDog test"
    default n
    
config UTEST_TS
    bool "TS test"
    default n

config UTEST_GPIO
    bool "GPIO test"
    default n

config UTEST_PWM
    bool "PWM test"
    default n

config UTEST_HWTIMER
    bool "hwtimer test"
    default n

config UTEST_RTC
    bool "rtc test"
    default n

endmenu
```

## src/big/rt-smart/userapps/Kconfig
```kconfig
choice
    prompt "CPU Arch"
    default CORTEX_A

    config CORTEX_A
        bool "ARM Cortex-A"

    config CORTEX_M
        bool "ARM Cortex-M"

    config AARCH64
        bool "ARM AArch64"

    config RISCV64
        bool "RISC-V 64"

    config I386
        bool "I386"
endchoice

config ARCH
    string
    default "Cortex-A" if CORTEX_A
    default "AArch64"  if AARCH64
    default "Cortex-M" if CORTEX_M
    default "RISCV64"  if RISCV64
    default "I386"     if I386
    default "Cortex-A"

choice
    prompt "Compiler"
    default GNU_GCC_MUSL

    config GNU_GCC
        bool "GNU GCC (with RT-Thread ulibc)"

    config GNU_GCC_MUSL
        bool "GNU GCC with builtin musl libc"
    
    config GNU_GCC_NEWLIB
        bool "GNU GCC with builtin newlib libc"
endchoice

config Toolchain
    string
    default "gcc" if GNU_GCC
    default "gcc_musl" if GNU_GCC_MUSL
    default "gcc_newlib" if GNU_GCC_NEWLIB
    default "gcc"

config EXEC_PATH
    string "Toolchain Path"
    default "/opt/bin"

config CUSTOM_PREFIX
    bool "Using specific prefix of toolchain"
    default n

if CUSTOM_PREFIX
    config PREFIX
        string "Prefix of toolchain"
        default "arm-linux-musleabi-" if GNU_GCC_MUSL && CORTEX_A
        default "aarch64-linux-musleabi-" if GNU_GCC_MUSL && AARCH64
        default "riscv64-unknown-linux-musl-" if GNU_GCC_MUSL && RISCV64
        default "i386-unknown-linux-musl-" if GNU_GCC_MUSL && I386
        default "arm-none-eabi-"
endif

if !CUSTOM_PREFIX
    config PREFIX
        string
        default "arm-none-eabi-" if GNU_GCC_NEWLIB
        default "arm-linux-musleabi-" if GNU_GCC_MUSL && CORTEX_A
        default "aarch64-linux-musleabi-" if GNU_GCC_MUSL && AARCH64
        default "riscv64-unknown-linux-musl-" if GNU_GCC_MUSL && RISCV64
        default "i386-unknown-linux-musl-" if GNU_GCC_MUSL && I386
        default "arm-none-eabi-"
endif

config TARGET_FILE
    string
    default ""
```
