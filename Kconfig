## src/little/buildroot-ext/Config.in
```kconfig
source "$BR2_EXTERNAL_K230_PATH/package/hello_world/Config.in"
source "$BR2_EXTERNAL_K230_PATH/package/hw-c910/Config.in"
source "$BR2_EXTERNAL_K230_PATH/package/vg_lite/Config.in"
source "$BR2_EXTERNAL_K230_PATH/package/i2c-tool/Config.in"
source "$BR2_EXTERNAL_K230_PATH/package/gpio_keys/Config.in"
source "$BR2_EXTERNAL_K230_PATH/package/usb_test/Config.in"
source "$BR2_EXTERNAL_K230_PATH/package/wdt_test/Config.in"
source "$BR2_EXTERNAL_K230_PATH/package/aiw4211lv10/Config.in"
source "$BR2_EXTERNAL_K230_PATH/package/otp_test/Config.in"
source "$BR2_EXTERNAL_K230_PATH/package/trng_test/Config.in"
source "$BR2_EXTERNAL_K230_PATH/package/ts_test/Config.in"
source "$BR2_EXTERNAL_K230_PATH/package/lvgl/Config.in"
source "$BR2_EXTERNAL_K230_PATH/package/libdisp/Config.in"
source "$BR2_EXTERNAL_K230_PATH/package/door_lock/Config.in"
source "$BR2_EXTERNAL_K230_PATH/package/peephole_phone/Config.in"
source "$BR2_EXTERNAL_K230_PATH/package/peephole_device/Config.in"
source "$BR2_EXTERNAL_K230_PATH/package/touch_emu/Config.in"
source "$BR2_EXTERNAL_K230_PATH/package/ota/Config.in"
source "$BR2_EXTERNAL_K230_PATH/package/crypto_test/Config.in"
source "$BR2_EXTERNAL_K230_PATH/package/k230_timer/Config.in"
source "$BR2_EXTERNAL_K230_PATH/package/ws2812/Config.in"
source "$BR2_EXTERNAL_K230_PATH/package/mvx_player/Config.in"
source "$BR2_EXTERNAL_K230_PATH/package/amp_app/Config.in"
#source "$BR2_EXTERNAL_K230_PATH/package/ffmpeg_canaan/Config.in"
source "$BR2_EXTERNAL_K230_PATH/package/time_sync/Config.in"
source "$BR2_EXTERNAL_K230_PATH/package/bluez_inc/Config.in"
source "$BR2_EXTERNAL_K230_PATH/package/bt_test/Config.in"
```

## src/little/buildroot-ext/configs/k230_evb_peephole_phone_defconfig
```kconfig
BR2_riscv=y
BR2_riscv_custom=y
BR2_RISCV_ISA_CUSTOM_RVM=y
BR2_RISCV_ISA_CUSTOM_RVF=y
BR2_RISCV_ISA_CUSTOM_RVD=y
BR2_RISCV_ISA_CUSTOM_RVC=y
BR2_RISCV_ISA_CUSTOM_THEAD=y
BR2_DL_DIR="$(TOPDIR)/../dl"
BR2_SHARED_STATIC_LIBS=y
BR2_GLOBAL_PATCH_DIR="$(TOPDIR)/../package/patches"
BR2_TOOLCHAIN_EXTERNAL=y
BR2_TOOLCHAIN_EXTERNAL_PATH="/data/toolchain/T-head/Xuantie-900-gcc-linux-5.10.4-glibc-x86_64-V2.6.0"
BR2_TOOLCHAIN_EXTERNAL_CUSTOM_PREFIX="riscv64-unknown-linux-gnu"
BR2_TOOLCHAIN_EXTERNAL_HEADERS_5_10=y
BR2_TOOLCHAIN_EXTERNAL_CUSTOM_GLIBC=y
# BR2_TOOLCHAIN_EXTERNAL_INET_RPC is not set
BR2_TOOLCHAIN_EXTERNAL_CXX=y
BR2_PACKAGE_HOST_GDB=y
BR2_ROOTFS_DEVICE_CREATION_DYNAMIC_MDEV=y
BR2_ROOTFS_DEVICE_TABLE="$(TOPDIR)/../board/canaan/k230/device_table.txt"
BR2_ROOTFS_POST_IMAGE_SCRIPT="$(TOPDIR)/../board/canaan/k230/post-image.sh"
BR2_PACKAGE_BUSYBOX_CONFIG_FRAGMENT_FILES="$(TOPDIR)/../board/canaan/k230/defconfigs/busybox-riscv.fragment"
BR2_PACKAGE_BUSYBOX_SHOW_OTHERS=y
BR2_PACKAGE_FIO=y
BR2_PACKAGE_LMBENCH=y
BR2_PACKAGE_RAMSMP=y
BR2_PACKAGE_RAMSPEED=y
BR2_PACKAGE_STRESS_NG=y
BR2_PACKAGE_TRACE_CMD=y
BR2_PACKAGE_DOSFSTOOLS=y
BR2_PACKAGE_DOSFSTOOLS_FATLABEL=y
BR2_PACKAGE_DOSFSTOOLS_FSCK_FAT=y
BR2_PACKAGE_DOSFSTOOLS_MKFS_FAT=y
BR2_PACKAGE_MTD=y
BR2_PACKAGE_MTD_JFFS2DUMP=y
BR2_PACKAGE_MTD_MKFSJFFS2=y
BR2_PACKAGE_MTD_MKFSUBIFS=y
BR2_PACKAGE_I2C_TOOLS=y
BR2_PACKAGE_MEMTESTER=y
BR2_PACKAGE_LIBDRM=y
BR2_PACKAGE_LIBDRM_INSTALL_TESTS=y
BR2_PACKAGE_LIBFFI=y
BR2_PACKAGE_HOSTAPD=y
BR2_PACKAGE_HOSTAPD_EAP=y
BR2_PACKAGE_HOSTAPD_WPS=y
BR2_PACKAGE_HOSTAPD_WPA3=y
BR2_PACKAGE_LRZSZ=y
BR2_PACKAGE_OPENSSH=y
BR2_PACKAGE_WIRELESS_TOOLS=y
BR2_PACKAGE_WIRELESS_TOOLS_LIB=y
BR2_PACKAGE_WPA_SUPPLICANT=y
BR2_PACKAGE_WPA_SUPPLICANT_AP_SUPPORT=y
BR2_PACKAGE_WPA_SUPPLICANT_WIFI_DISPLAY=y
BR2_PACKAGE_WPA_SUPPLICANT_MESH_NETWORKING=y
BR2_PACKAGE_WPA_SUPPLICANT_AUTOSCAN=y
BR2_PACKAGE_WPA_SUPPLICANT_EAP=y
BR2_PACKAGE_WPA_SUPPLICANT_HOTSPOT=y
BR2_PACKAGE_WPA_SUPPLICANT_DEBUG_SYSLOG=y
BR2_PACKAGE_WPA_SUPPLICANT_WPS=y
BR2_PACKAGE_WPA_SUPPLICANT_WPA3=y
BR2_PACKAGE_WPA_SUPPLICANT_CLI=y
BR2_PACKAGE_WPA_SUPPLICANT_PASSPHRASE=y
BR2_PACKAGE_WPA_SUPPLICANT_DBUS=y
BR2_PACKAGE_BASH=y
BR2_TARGET_ROOTFS_CPIO=y
BR2_TARGET_ROOTFS_CPIO_GZIP=y
BR2_TARGET_ROOTFS_EXT2=y
BR2_TARGET_OPENSBI=y
BR2_PACKAGE_HOST_ANDROID_TOOLS=y
BR2_PACKAGE_HOST_ANDROID_TOOLS_EXT4_UTILS=y
BR2_PACKAGE_HOST_DTC=y
BR2_PACKAGE_HOST_GENIMAGE=y
BR2_PACKAGE_HOST_UBOOT_TOOLS=y
BR2_PACKAGE_VG_LITE_DEMOS=y
BR2_PACKAGE_GPIO_KEYS=y
BR2_PACKAGE_WDT_TEST=y
BR2_PACKAGE_AIW4211LV10=y
BR2_PACKAGE_OTP_TEST=y
BR2_PACKAGE_TRNG_TEST=y
BR2_PACKAGE_TS_TEST=y
BR2_PACKAGE_LVGL=y
BR2_PACKAGE_TOUCH_EMU=y
BR2_PACKAGE_CRYPTO_TEST=y
BR2_PACKAGE_K230_TIMER=y
BR2_PACKAGE_PEEPHOLE_PHONE=y
```

## src/little/buildroot-ext/configs/k230_fpga_defconfig
```kconfig
BR2_DL_DIR="$(TOPDIR)/../dl"
BR2_riscv=y
BR2_riscv_custom=y
BR2_RISCV_ISA_CUSTOM_RVM=y
BR2_RISCV_ISA_CUSTOM_RVF=y
BR2_RISCV_ISA_CUSTOM_RVD=y
BR2_RISCV_ISA_CUSTOM_RVC=y
BR2_RISCV_ISA_CUSTOM_THEAD=y
BR2_SHARED_STATIC_LIBS=y
BR2_GLOBAL_PATCH_DIR="$(TOPDIR)/../package/patches"
BR2_TOOLCHAIN_EXTERNAL=y
BR2_TOOLCHAIN_EXTERNAL_PATH="/data/toolchain/T-head/Xuantie-900-gcc-linux-5.10.4-glibc-x86_64-V2.6.0"
BR2_TOOLCHAIN_EXTERNAL_CUSTOM_PREFIX="riscv64-unknown-linux-gnu"
BR2_TOOLCHAIN_EXTERNAL_HEADERS_5_10=y
BR2_TOOLCHAIN_EXTERNAL_CUSTOM_GLIBC=y
# BR2_TOOLCHAIN_EXTERNAL_INET_RPC is not set
BR2_TOOLCHAIN_EXTERNAL_CXX=y
BR2_PACKAGE_HOST_GDB=y
BR2_ROOTFS_DEVICE_CREATION_DYNAMIC_MDEV=y
BR2_ROOTFS_DEVICE_TABLE="$(TOPDIR)/../board/canaan/k230/device_table.txt"
BR2_ROOTFS_POST_IMAGE_SCRIPT="$(TOPDIR)/../board/canaan/k230/post-image.sh"
BR2_PACKAGE_BUSYBOX_CONFIG_FRAGMENT_FILES="$(TOPDIR)/../board/canaan/k230/defconfigs/busybox-riscv.fragment"
BR2_PACKAGE_BUSYBOX_SHOW_OTHERS=y
BR2_PACKAGE_FIO=y
BR2_PACKAGE_LMBENCH=y
BR2_PACKAGE_RAMSMP=y
BR2_PACKAGE_RAMSPEED=y
BR2_PACKAGE_TRACE_CMD=y
BR2_PACKAGE_BASH=y
BR2_TARGET_ROOTFS_CPIO=y
BR2_TARGET_ROOTFS_CPIO_GZIP=y
BR2_TARGET_ROOTFS_EXT2=y
BR2_TARGET_OPENSBI=y
BR2_PACKAGE_HOST_ANDROID_TOOLS=y
BR2_PACKAGE_HOST_ANDROID_TOOLS_EXT4_UTILS=y
BR2_PACKAGE_HOST_UBOOT_TOOLS=y
BR2_PACKAGE_HOST_GENIMAGE=y
BR2_PACKAGE_HOST_DTC=y
BR2_PACKAGE_HW_C910=y
BR2_PACKAGE_VG_LITE=y
BR2_PACKAGE_I2C_TOOLS=y
BR2_PACKAGE_GPIO_KEYS=y
# BR2_PACKAGE_TUNING_SERVER is not set
```

## src/little/buildroot-ext/package/aiw4211lv10/Config.in
```kconfig
config BR2_PACKAGE_AIW4211LV10
	bool "aiw4211lv10"
	help
	  wifi aiw4211lv10 tools
```
