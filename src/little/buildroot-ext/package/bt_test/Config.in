## src/little/buildroot-ext/package/crypto_test/Config.in
```kconfig
config BR2_PACKAGE_CRYPTO_TEST
	bool "crypto test"
	help
	  k230 crypto demo for test
```

## src/little/buildroot-ext/package/ffmpeg_canaan/Config.in
```kconfig
config BR2_PACKAGE_FFMPEG_CANAAN
	bool "ffmpeg app"
	depends on BR2_riscv
	help
	  k510 ffmpeg app

menuconfig BR2_PACKAGE_FFMPEG_CANAAN
	bool "ffmpeg"
	depends on BR2_PACKAGE_FFMPEG_CANAAN_ARCH_SUPPORTS
	help
	  FFmpeg is a complete, cross-platform solution to record,
	  convert and stream audio and video.

	  http://www.ffmpeg.org

if BR2_PACKAGE_FFMPEG_CANAAN

config BR2_PACKAGE_FFMPEG_CANAAN_GPL
	bool "Enable GPL code"
	help
	  allow use of GPL code, the resulting libs and binaries will
	  be under GPL

config BR2_PACKAGE_FFMPEG_CANAAN_NONFREE
	bool "Enable nonfree code"
	help
	  allow use of nonfree code, the resulting libs and binaries
	  will be unredistributable

config BR2_PACKAGE_FFMPEG_CANAAN_FFMPEG_CANAAN
	bool "Build ffmpeg (the command line application)"
	default y
	help
	  FFmpeg is a very fast video and audio converter.
	  It can also grab from a live audio/video source.

	  It is not needed if you want to link the FFmpeg libraries
	  to your application.

config BR2_PACKAGE_FFMPEG_CANAAN_FFPLAY
	bool "Build ffplay"
	depends on !BR2_STATIC_LIBS # sdl2
	select BR2_PACKAGE_FFMPEG_CANAAN_SWSCALE
	select BR2_PACKAGE_SDL2
	help
	  FFplay is a very simple and portable media player using the
	  FFmpeg libraries and the SDL library.
	  It is mostly used as a testbed for the various FFmpeg APIs.

comment "ffplay needs a toolchain w/ dynamic library"
	depends on BR2_STATIC_LIBS

config BR2_PACKAGE_FFMPEG_CANAAN_FFPROBE
	bool "Build ffprobe"
	help
	  FFprobe is a utility to determine the audio and video
	  characteristics of a container file.

config BR2_PACKAGE_FFMPEG_CANAAN_XCBGRAB
	bool "Build X11 screen grabbing"
	depends on BR2_PACKAGE_XORG7
	select BR2_PACKAGE_LIBXCB
	help
	  X11 screen grabbing using libxcb.

config BR2_PACKAGE_FFMPEG_CANAAN_AVRESAMPLE
	bool "Build libavresample"
	help
	  Avresample is a audio conversion library for compatibility.

config BR2_PACKAGE_FFMPEG_CANAAN_POSTPROC
	bool "Build libpostproc"
	depends on BR2_PACKAGE_FFMPEG_CANAAN_GPL
	help
	  Postproc is a library of video postprocessing routines.

config BR2_PACKAGE_FFMPEG_CANAAN_SWSCALE
	bool "Build libswscale"
	help
	  Swscale is a library of video scaling routines.

config BR2_PACKAGE_FFMPEG_CANAAN_ENCODERS
	string "Enabled encoders"
	default "all"
	help
	  Space-separated list of encoders to build in FFmpeg,
	  or "all" to build all of them.

	  Run ./configure --list-encoders in the ffmpeg sources
	  directory to know the available options.

config BR2_PACKAGE_FFMPEG_CANAAN_DECODERS
	string "Enabled decoders"
	default "all"
	help
	  Space-separated list of decoders to build in FFmpeg,
	  or "all" to build all of them.

	  Run ./configure --list-decoders in the ffmpeg sources
	  directory to know the available options.

config BR2_PACKAGE_FFMPEG_CANAAN_MUXERS
	string "Enabled muxers"
	default "all"
	help
	  Space-separated list of muxers to build in FFmpeg,
	  or "all" to build all of them.

	  Run ./configure --list-muxers in the ffmpeg sources
	  directory to know the available options.

config BR2_PACKAGE_FFMPEG_CANAAN_DEMUXERS
	string "Enabled demuxers"
	default "all"
	help
	  Space-separated list of demuxers to build in FFmpeg,
	  or "all" to build all of them.

	  Run ./configure --list-demuxers in the ffmpeg sources
	  directory to know the available options.

config BR2_PACKAGE_FFMPEG_CANAAN_PARSERS
	string "Enabled parsers"
	default "all"
	help
	  Space-separated list of parsers to build in FFmpeg,
	  or "all" to build all of them.

	  Run ./configure --list-parsers in the ffmpeg sources
	  directory to know the available options.

config BR2_PACKAGE_FFMPEG_CANAAN_BSFS
	string "Enabled bitstreams"
	default "all"
	help
	  Space-separated list of bitstream filters to build in FFmpeg,
	  or "all" to build all of them.

	  Run ./configure --list-bsfs in the ffmpeg sources
	  directory to know the available options.

config BR2_PACKAGE_FFMPEG_CANAAN_PROTOCOLS
	string "Enabled protocols"
	default "all"
	help
	  Space-separated list of protocols to build in FFmpeg,
	  or "all" to build all of them.

	  Run ./configure --list-protocols in the ffmpeg sources
	  directory to know the available options.

config BR2_PACKAGE_FFMPEG_CANAAN_FILTERS
	string "Enabled filters"
	default "all"
	help
	  Space-separated list of filters to build in FFmpeg,
	  or "all" to build all of them.

	  Run ./configure --list-filters in the ffmpeg sources
	  directory to know the available options.

config BR2_PACKAGE_FFMPEG_CANAAN_INDEVS
	bool "Enable input devices"
	default y

config BR2_PACKAGE_FFMPEG_CANAAN_OUTDEVS
	bool "Enable output devices"
	default y

config BR2_PACKAGE_FFMPEG_CANAAN_EXTRACONF
	string "Additional parameters for ./configure"
	default ""
	help
	  Extra parameters that will be appended to FFmpeg's
	  ./configure commandline.

endif
```

## src/little/buildroot-ext/package/gpio_keys/Config.in
```kconfig
config BR2_PACKAGE_GPIO_KEYS
	bool "gpio keys"
	help
	  k230 gpio keys demo for test
```

## src/little/buildroot-ext/package/hello_world/Config.in
```kconfig
config BR2_PACKAGE_HELLO_WORLD
	bool "hello world"
	depends on BR2_riscv
	help
	  k510 hello world demo
```

## src/little/buildroot-ext/package/k230_timer/Config.in
```kconfig
config BR2_PACKAGE_K230_TIMER
	bool "k230 timer test"
	help
	  k230 timer demo for test
```

## src/little/buildroot-ext/package/peephole_device/Config.in
```kconfig
config BR2_PACKAGE_PEEPHOLE_DEVICE
	bool "peephole device"
	default n
	select BR2_PACKAGE_LIBDISP
	help
	  peephole device app
```

## src/little/buildroot-ext/package/peephole_phone/Config.in
```kconfig
config BR2_PACKAGE_PEEPHOLE_PHONE
	bool "Simulate phone app for peephole"
	default n
	select BR2_PACKAGE_LIBDISP
	help
	  Simulate phone app for peephole
```

## src/little/buildroot-ext/package/touch_emu/Config.in
```kconfig
config BR2_PACKAGE_TOUCH_EMU
	bool "touchscreen emulator"
	help
	  k230 touchscreen emulator
```

## src/little/buildroot-ext/package/vg_lite/Config.in
```kconfig
config BR2_PACKAGE_VG_LITE
    bool "VGLite GPU user-space library"
    help
        VGLite GPU user-space library

config BR2_PACKAGE_VG_LITE_DEMOS
    bool "VGLite GPU demos"
    select BR2_PACKAGE_VG_LITE
    help
        VGLite GPU test samples
```

## src/little/buildroot-ext/package/wdt_test/Config.in
```kconfig
config BR2_PACKAGE_WDT_TEST
	bool "watchdog test"
	help
	  k230 watchdog demo for test
```

## src/little/buildroot-ext/package/ws2812/Config.in
```kconfig
config BR2_PACKAGE_WS2812
	bool "ws2812 rgb leds demo"
	help
	  ws2812 i2s demo for test
```
