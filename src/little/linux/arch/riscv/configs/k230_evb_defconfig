## src/little/linux/arch/riscv/configs/k230d_canmv_defconfig
```kconfig
# CONFIG_LOCALVERSION_AUTO is not set
CONFIG_DEFAULT_HOSTNAME="K230"
CONFIG_SYSVIPC=y
CONFIG_POSIX_MQUEUE=y

CONFIG_CGROUPS=y
CONFIG_CGROUP_SCHED=y
CONFIG_CFS_BANDWIDTH=y
CONFIG_EXPERT=y
CONFIG_PERF_EVENTS=y
# CONFIG_SLUB_DEBUG is not set
# CONFIG_SLUB_CPU_PARTIAL is not set
CONFIG_SOC_THEAD=y
CONFIG_SECTION_ALIGN_4KB=y
CONFIG_SMP=y
CONFIG_PM=y
# CONFIG_EFI is not set
# CONFIG_SECCOMP is not set
CONFIG_MODULES=y
CONFIG_MODULE_UNLOAD=y
# CONFIG_BLK_DEBUG_FS is not set
CONFIG_PARTITION_ADVANCED=y
CONFIG_BSD_DISKLABEL=y
CONFIG_LDM_PARTITION=y
CONFIG_LDM_DEBUG=y
# CONFIG_COREDUMP is not set
CONFIG_PAGE_REPORTING=y
CONFIG_NET=y
CONFIG_PACKET=y
CONFIG_UNIX=y
CONFIG_INET=y
CONFIG_IP_MULTICAST=y
# CONFIG_IPV6 is not set
CONFIG_DNS_RESOLVER=y
CONFIG_NETLINK_DIAG=y
CONFIG_CFG80211=y
# CONFIG_CFG80211_DEFAULT_PS is not set
# CONFIG_CFG80211_CRDA_SUPPORT is not set
CONFIG_CFG80211_WEXT=y
# CONFIG_ETHTOOL_NETLINK is not set
CONFIG_DEVTMPFS=y
CONFIG_DEVTMPFS_MOUNT=y

CONFIG_SCSI=y
CONFIG_BLK_DEV_SD=y
CONFIG_NETDEVICES=y
# CONFIG_ETHERNET is not set

CONFIG_MARVELL_PHY=y
CONFIG_USB_CATC=m
CONFIG_USB_KAWETH=m
CONFIG_USB_PEGASUS=m
CONFIG_USB_RTL8150=m
CONFIG_USB_RTL8152=m
CONFIG_USB_LAN78XX=m
CONFIG_USB_USBNET=m
# CONFIG_USB_NET_ZAURUS is not set
# CONFIG_WLAN_VENDOR_ADMTEK is not set
# CONFIG_AIW4211LV10=m
# CONFIG_WLAN_VENDOR_ATH is not set
# CONFIG_WLAN_VENDOR_ATMEL is not set
# CONFIG_WLAN_VENDOR_BROADCOM is not set
# CONFIG_WLAN_VENDOR_CISCO is not set
# CONFIG_WLAN_VENDOR_INTEL is not set
CONFIG_HOSTAP=y
# CONFIG_WLAN_VENDOR_MARVELL is not set
# CONFIG_WLAN_VENDOR_MEDIATEK is not set
# CONFIG_WLAN_VENDOR_MICROCHIP is not set
# CONFIG_WLAN_VENDOR_RALINK is not set
# CONFIG_WLAN_VENDOR_REALTEK is not set
# CONFIG_WLAN_VENDOR_RSI is not set
# CONFIG_WLAN_VENDOR_ST is not set
# CONFIG_WLAN_VENDOR_TI is not set
# CONFIG_WLAN_VENDOR_ZYDAS is not set
# CONFIG_WLAN_VENDOR_QUANTENNA is not set
CONFIG_INPUT_EVDEV=y
# CONFIG_KEYBOARD_ATKBD is not set
# CONFIG_KEYBOARD_GPIO is not set
# CONFIG_INPUT_MOUSE is not set
CONFIG_INPUT_TOUCHSCREEN=y
CONFIG_TOUCHSCREEN_GOODIX=y
# CONFIG_SERIO is not set

CONFIG_SERIAL_8250=y
# CONFIG_SERIAL_8250_DEPRECATED_OPTIONS is not set
CONFIG_SERIAL_8250_CONSOLE=y
CONFIG_SERIAL_8250_NR_UARTS=5
CONFIG_SERIAL_8250_RUNTIME_UARTS=5
CONFIG_SERIAL_8250_DW=y
CONFIG_SERIAL_OF_PLATFORM=y
CONFIG_SERIAL_EARLYCON_RISCV_SBI=y
CONFIG_HVC_RISCV_SBI=y
CONFIG_HW_RANDOM=y

CONFIG_I2C_CHARDEV=y
CONFIG_I2C_MUX=y
CONFIG_I2C_DESIGNWARE_PLATFORM=y
CONFIG_I2C_DESIGNWARE_ICE=y
CONFIG_GPIOLIB=y
CONFIG_GPIO_SYSFS=y
CONFIG_POWER_RESET=y
CONFIG_POWER_SUPPLY=y
# CONFIG_HWMON is not set
# CONFIG_THERMAL=y
# CONFIG_CANAAN_THERMAL=m
CONFIG_WATCHDOG=y
CONFIG_DW_WATCHDOG=y

CONFIG_DRM=n
CONFIG_DRM_PANEL_CANAAN_UNIVERSAL=n
CONFIG_DRM_CANAAN=n
CONFIG_DRM_CANAAN_DSI=n
CONFIG_FB_VIRTUAL=m
CONFIG_FB_SIMPLE=y
CONFIG_LCD_CLASS_DEVICE=y
CONFIG_BACKLIGHT_CLASS_DEVICE=y
# CONFIG_VGA_CONSOLE is not set
CONFIG_USB=y
CONFIG_USB_ANNOUNCE_NEW_DEVICES=y
CONFIG_USB_STORAGE=y
CONFIG_USB_DWC2=y
CONFIG_USB_TEST=m
CONFIG_USB_GADGET=y
CONFIG_USB_SNP_UDC_PLAT=y
CONFIG_USB_CONFIGFS=y
CONFIG_USB_CONFIGFS_MASS_STORAGE=y
CONFIG_USB_CONFIGFS_F_LB_SS=y
CONFIG_MMC=y
CONFIG_MMC_DEBUG=y
CONFIG_MMC_SDHCI=y
CONFIG_MMC_SDHCI_PLTFM=y
CONFIG_MMC_SDHCI_OF_KENDRYTE=y

# CONFIG_VIRTIO_MENU is not set
# CONFIG_VHOST_MENU is not set

# CONFIG_IOMMU_SUPPORT is not set
CONFIG_SIFIVE_PLIC=y

CONFIG_GENERIC_PHY=y
CONFIG_RAS=y
CONFIG_NVMEM_KENDRYTE_K230_OTP=y
CONFIG_EXT4_FS=y
CONFIG_EXT4_FS_POSIX_ACL=y

CONFIG_VFAT_FS=y
CONFIG_FAT_DEFAULT_UTF8=y
CONFIG_EXFAT_FS=y
CONFIG_PROC_CHILDREN=y
CONFIG_TMPFS=y
CONFIG_TMPFS_POSIX_ACL=y


CONFIG_NLS_CODEPAGE_437=y
CONFIG_NLS_CODEPAGE_936=y
CONFIG_NLS_CODEPAGE_1250=y
CONFIG_NLS_CODEPAGE_1251=y
CONFIG_NLS_ISO8859_1=y
CONFIG_NLS_UTF8=y
CONFIG_LSM="lockdown,yama,loadpin,safesetid,integrity"
CONFIG_CRYPTO_LZO=y
CONFIG_CRYPTO_USER_API_HASH=y
CONFIG_XZ_DEC=y
CONFIG_PRINTK_TIME=y
# CONFIG_SYMBOLIC_ERRNAME is not set
# CONFIG_DEBUG_BUGVERBOSE is not set
# CONFIG_ENABLE_MUST_CHECK is not set
CONFIG_DEBUG_FS=y
# CONFIG_DEBUG_MISC is not set
CONFIG_DETECT_HUNG_TASK=y
CONFIG_DEFAULT_HUNG_TASK_TIMEOUT=60
# CONFIG_SCHED_DEBUG is not set
CONFIG_DEBUG_ATOMIC_SLEEP=y
CONFIG_STACKTRACE=y
# CONFIG_RCU_TRACE is not set
# CONFIG_FTRACE is not set
# CONFIG_RUNTIME_TESTING_MENU is not set
CONFIG_CRYPTO_USER=y
CONFIG_CRYPTO_USER_API_HASH=y
CONFIG_CRYPTO_USER_API_AEAD=y
CONFIG_CRYPTO_DEV_CANAAN=y
CONFIG_CRYPTO_DEV_KENDRYTE_CRYP=y
CONFIG_CRYPTO_DEV_KENDRYTE_HASH=y
```

## src/little/linux/drivers/canaan-hardlock/Kconfig
```kconfig
menu "canaan-hardlock"


config CANAAN_HARDLOCK
	bool "canaan hardlock driver"
	default y

endmenu
```

## src/little/linux/drivers/canaan-hwtimer/Kconfig
```kconfig
menu "canaan-hwtimer"


config CANAAN_HWTIMER
	bool "canaan hwtimer driver"
	default n

endmenu
```

## src/little/linux/drivers/canaan-ws2812/Kconfig
```kconfig
menu "canaan-i2s-ws2812"

config CANAAN_I2S_WS2812
	bool "canaan k230 i2s surport ws2812 leds."
	default n

endmenu
```

## src/little/linux/drivers/clk/canaan/Kconfig
```kconfig
# SPDX-License-Identifier: GPL-2.0
#
# k230 clock configuration
#
menuconfig CANAAN_CLK		#config canaan dir enable
	bool "canaan clk driver support"
	default y

if CANAAN_CLK
	config CLK_K230		#config the clk_k230.c can be compiled
	bool "k230 clk"
	default y
endif
```

## src/little/linux/drivers/crypto/canaan/Kconfig
```kconfig
# SPDX-License-Identifier: GPL-2.0
#
# k230 AES-GCM configuration
#
config CRYPTO_DEV_KENDRYTE_CRYP
    tristate "Support for K230 crypto accelerators"
    select CRYPTO_AES
    select CRYPTO_BLKCIPHER
    help
        This driver interfaces with the hardware crypto accelerator.
        Supporting gcm mode.

config CRYPTO_DEV_KENDRYTE_HASH
    tristate "Support for K230 sha256 accelerators"
    select CRYPTO_HASH
    select CRYPTO_SHA256
    help
        This driver interfaces with the hardware hash accelerator.
        Supporting sha256 hashing algo.

config CRYPTO_DEV_KENDRYTE_RSA
    tristate "Support for k230 rsa-2048 accelerator"
    select CRYPTO_SKCIPHER
    help
        This driver interfaces with the hardware rsa accelerator.
        Supporting rsa algo.
```

## src/little/linux/drivers/gpu/drm/canaan/Kconfig
```kconfig
# SPDX-License-Identifier: GPL-2.0-only
config DRM_CANAAN
    tristate "DRM Support for Canaan K230 Display Controller"
    depends on DRM
    depends on OF
    depends on COMMON_CLK
    select DRM_KMS_HELPER
    select DRM_KMS_CMA_HELPER
    select DRM_GEM_CMA_HELPER
    select VIDEOMODE_HELPERS
    help
        Choose this option to enable DRM on Canaan K230 chipset

if DRM_CANAAN

config DRM_CANAAN_DSI
	tristate "Canaan K230 MIPI-DSI Controller Support"
	select DRM_MIPI_DSI
	help
        Choose this option to enable Canaan K230 MIPI-DSI Controller

endif
```

## src/little/linux/drivers/gpu/vglite/Kconfig
```kconfig
# SPDX-License-Identifier: GPL-2.0-only
config VG_LITE
	tristate "VGLite device driver"
	default n
	help
	  VGLite GPU
```

## src/little/linux/drivers/media/platform/canaan-vpu/Kconfig
```kconfig
config VPU_CANAAN
	tristate "Linlon VPU support."
	depends on VIDEO_DEV
	depends on COMMON_CLK && HAS_DMA
	select VIDEO_V4L2_SUBDEV_API
	select VIDEOBUF2_DMA_CONTIG
	select V4L_MEM2MEM_DRIVERS
	select V4L2_FWNODE
	select VIDEOBUF2_DMA_SG
	default y
	help
	  This enables support for the Linlon VPU family.

config VPU_CANAAN_FTRACE
	depends on VPU_CANAAN
	bool "Send kernel space logs to ftrace."
	default n
	help
		Send kernel space logs to ftrace.

config VPU_CANAAN_PRINT_FILE
	depends on VPU_CANAAN
	bool "Append file and line number to kernel space log messages."
	default y
	help
		Append file and line number to kernel space log messages.
```

## src/little/linux/drivers/misc/canaan/Kconfig
```kconfig
    config K230_AMP_DRIVER
        tristate "K230 amp driver"
        help
          Say Y for enabling the K230 amp driver

          To compile this support as a module, choose M here:
          If unsure, say N.
```

## src/little/linux/drivers/net/wireless/aic8800/Kconfig
```kconfig
config AIC_WLAN_SUPPORT
	tristate "AIC wireless Support"
	default n
	help
	  This is support for aic wireless chip.

if AIC_WLAN_SUPPORT
source "drivers/net/wireless/aic8800/aic8800_fdrv/Kconfig"
source "drivers/net/wireless/aic8800/aic_load_fw/Kconfig"
endif
```

## src/little/linux/drivers/net/wireless/aich/aiw4211lv10/Kconfig
```kconfig
# SPDX-License-Identifier: GPL-2.0-only
config AIW4211LV10
	tristate "Aich AiW4211LV10 (SDIO) support"
	depends on CFG80211
	help
	  This adds support for AiW4211LV10 wireless SDIO dongles.
```

## src/little/linux/drivers/reset/canaan/Kconfig
```kconfig
# SPDX-License-Identifier: GPL-2.0
#
# k230 reset configuration
#
menuconfig CANAAN_RST		#config canaan dir enable
	bool "canaan rst driver support"
	default y

if CANAAN_RST
	config RESET_K230		#config the reset_k230.c can be compiled
	bool "k230 rst"
	default y
endif
```

## src/little/linux/drivers/soc/canaan/Kconfig
```kconfig
# SPDX-License-Identifier: GPL-2.0
#
# k230 power configuration
#
menuconfig CANAAN_PWR		#config canaan dir enable
	bool "canaan pwr driver support"
	select PM_GENERIC_DOMAINS if PM
	default y

if CANAAN_PWR
	config K230_PM_DOMAINS		#config the k230_pm_domains.c can be compiled
	bool "k230 power"
	default y
endif
```

## src/little/linux/drivers/soc/kendryte/Kconfig
```kconfig
# SPDX-License-Identifier: GPL-2.0

if SOC_KENDRYTE

config K210_SYSCTL
	bool "Kendryte K210 system controller"
	default y
	depends on RISCV
	help
	  Enables controlling the K210 various clocks and to enable
	  general purpose use of the extra 2MB of SRAM normally
	  reserved for the AI engine.

endif

if SOC_THEAD

menu "K230 SoC drivers"

config K230_PMU
	bool "K230 power management unit"
	default y
	help
	  Enables K230 PMU control PMIC.

endmenu

endif
```

## src/little/linux/sound/soc/canaan/Kconfig
```kconfig
config SND_SOC_CANAAN_K230_INNO
	tristate "ASoC support for CANAAN boards using a inno codec"
	help
	  Say Y or M here if you want to add support for SoC audio on CANAAN K230
	  boards using the INNO codec.

config SND_SOC_CANAAN_K230_AUDIO
	tristate "CANAAN K230 AUDIO interface support"
	help
	  Say Y or M here if you want to enable audio for canaan soc.
```

## src/little/uboot/arch/riscv/cpu/k230/Kconfig
```kconfig
#
# Copyright (C) 2017-2020 Alibaba Group Holding Limited
#
# SPDX-License-Identifier: GPL-2.0+
#

config RISCV_THEAD
	bool
	select ARCH_EARLY_INIT_R
	select SUPPORT_SPL
	imply CPU
	imply CPU_RISCV
	imply RISCV_TIMER
	imply RISCV_RDTIME
	imply CMD_CPU
	imply SPL_CPU
	imply SPL_OPENSBI
	imply SPL_LOAD_FIT



config DDR_SIZE
	hex "DDR  Size"
	default 0x80000000 if LPDDR4_2667
	default 0x08000000 if SIPLP4_3200_WODT
	default 0x08000000 if SIPLP4_3200_WALLODT
	default 0x08000000 if SIPLP4_2667
	default 0x08000000 if SIPLP4_1600
	default 0x20000000 
	help
	  Size of the DDR 
```

## src/little/uboot/board/canaan/k230_canmv/Kconfig
```kconfig
if TARGET_K230_CANMV

config SYS_CPU
	default "k230"
    
config SYS_VENDOR
    default "canaan"

config SYS_BOARD
    default "k230_canmv"

config SYS_CONFIG_NAME
    default "k230_evb"


config BOARD_SPECIFIC_OPTIONS # dummy
	def_bool y
	select RISCV_THEAD
choice
	prompt "ddr typy freq"
    default CANMV_LPDDR3_2133

    config CANMV_LPDDR3_2133
        bool  "k230 canmv ddr3 2133"    
endchoice
endif
```

## src/little/uboot/board/canaan/k230_canmv_01studio/Kconfig
```kconfig
if TARGET_K230_CANMV_01STUDIO

config SYS_CPU
	default "k230"
    
config SYS_VENDOR
    default "canaan"

config SYS_BOARD
    default "k230_canmv_01studio"

config SYS_CONFIG_NAME
    default "k230_evb"


config BOARD_SPECIFIC_OPTIONS # dummy
	def_bool y
	select RISCV_THEAD
choice  
	prompt "ddr typy freq"
    default CANMV_01STUDIO_LPDDR4_2667

config CANMV_01STUDIO_LPDDR3_2133
	bool  2133
config CANMV_01STUDIO_LPDDR3_1600
	bool  1600
config CANMV_01STUDIO_LPDDR3_800
	bool 800
config CANMV_01STUDIO_LPDDR4_2667
	bool LP4_2667
config CANMV_01STUDIO_LPDDR4_3200
	bool LP4_3200
endchoice
endif
```

## src/little/uboot/board/canaan/k230_canmv_dongshanpi/Kconfig
```kconfig
if TARGET_K230_CANMV_DONGSHANPI

config SYS_CPU
	default "k230"
    
config SYS_VENDOR
    default "canaan"

config SYS_BOARD
    default "k230_canmv_dongshanpi"

config SYS_CONFIG_NAME
    default "k230_evb"


config BOARD_SPECIFIC_OPTIONS # dummy
	def_bool y
	select RISCV_THEAD
    choice
        prompt "DDR Type And Frequency"
        default CANMV_DONGSHANPI_LPDDR3_1866

        config CANMV_DONGSHANPI_LPDDR3_2133
            bool "k230 canmv dongshanpi ddr3 2133"
        config CANMV_DONGSHANPI_LPDDR3_1866
            bool "k230 canmv dongshanpi ddr3 1866"
	config CANMV_DONGSHANPI_LPDDR4_2667
	    bool "k230 canmv dongshanpi ddr4 2667"
	config CANMV_DONGSHANPI_LPDDR4_3200
	    bool "k230 canmv dongshanpi ddr4 3200"
	config CANMV_DS_LPDDR4_1600_WITHOUT_ODT
	    bool "canmv  LP4_1600 WITHOUT ODT,"
	help
		"CANMV V3,lushanpai,01studio,dongshanpi"
    endchoice
endif
```

## src/little/uboot/board/canaan/k230_evb/Kconfig
```kconfig
if TARGET_K230_EVB

config SYS_CPU
	default "k230"
    
config SYS_VENDOR
    default "canaan"

config SYS_BOARD
    default "k230_evb"

config SYS_CONFIG_NAME
    default "k230_evb"


config BOARD_SPECIFIC_OPTIONS # dummy
	def_bool y
	select RISCV_THEAD
    
choice
	prompt "ddr typy freq"
	depends on TARGET_K230_EVB 
	default LPDDR3_800
	
config LPDDR3_800
	bool "ddr3 800"

config LPDDR3_2133
	bool  "ddr3 2133"

endchoice

endif
```

## src/little/uboot/board/canaan/k230_fpga/Kconfig
```kconfig
if TARGET_K230_FPGA

config SYS_CPU
	default "k230"
    
config SYS_VENDOR
    default "canaan"

config SYS_BOARD
    default "k230_fpga"

config SYS_CONFIG_NAME
    default "k230_fpga"


config BOARD_SPECIFIC_OPTIONS # dummy
	def_bool y
	select RISCV_THEAD
    

endif
```

## src/little/uboot/board/canaan/k230_siplp4/Kconfig
```kconfig
if TARGET_K230_SIPLP4

config SYS_CPU
	default "k230"

config SYS_VENDOR
	default "canaan"

config SYS_BOARD
	default "k230_siplp4"

config SYS_CONFIG_NAME
	default "k230_evb"


config BOARD_SPECIFIC_OPTIONS # dummy
	def_bool y
	select RISCV_THEAD

config SIPLP4_2667
	def_bool y

endif
```

## src/little/uboot/board/canaan/k230_unsiplp4/Kconfig
```kconfig
if TARGET_K230_UNSIPLP4

config SYS_CPU
	default "k230"
    
config SYS_VENDOR
    default "canaan"

config SYS_BOARD
    default "k230_unsiplp4"

config SYS_CONFIG_NAME
    default "k230_evb"


config BOARD_SPECIFIC_OPTIONS # dummy
	def_bool y
	select RISCV_THEAD

choice
	prompt "ddr typy freq"
	default LPDDR4_2667

    config LPDDR4_1066
        bool  "ddr4 1066"

    config LPDDR4_2667
        bool  "ddr4 2667"	
endchoice

endif
```
