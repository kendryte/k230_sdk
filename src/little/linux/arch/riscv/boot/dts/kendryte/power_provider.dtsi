/* Copyright (c) 2023, Canaan Bright Sight Co., Ltd
 *
 * This program is free software; you can redistribute it and/or modify
 * it under the terms of the GNU General Public License version 2 as
 * published by the Free Software Foundation.
*/

&sysctl_power {
    status              = "okay";
    compatible          = "canaan, k230-sysctl-power";
    hardlock            = <3>, <4>, <5>;
    #power-domain-cells = <1>;                          /* more than 1 power provider */
};
