/* Copyright (c) 2023, Canaan Bright Sight Co., Ltd
 *
 * Redistribution and use in source and binary forms, with or without
 * modification, are permitted provided that the following conditions are met:
 * 1. Redistributions of source code must retain the above copyright
 * notice, this list of conditions and the following disclaimer.
 * 2. Redistributions in binary form must reproduce the above copyright
 * notice, this list of conditions and the following disclaimer in the
 * documentation and/or other materials provided with the distribution.
 *
 * THIS SOFTWARE IS PROVIDED BY THE COPYRIGHT HOLDERS AND
 * CONTRIBUTORS "AS IS" AND ANY EXPRESS OR IMPLIED WARRANTIES,
 * INCLUDING, BUT NOT LIMITED TO, THE IMPLIED WARRANTIES OF
 * MERCHANTABILITY AND FITNESS FOR A PARTICULAR PURPOSE ARE
 * DISCLAIMED. IN NO EVENT SHALL THE COPYRIGHT HOLDER OR
 * CONTRIBUTORS BE LIABLE FOR ANY DIRECT, INDIRECT, INCIDENTAL,
 * SPECIAL, EXEMPLARY, OR CONSEQUENTIAL DAMAGES (INCLUDING,
 * BUT NOT LIMITED TO, PROCUREMENT OF SUBSTITUTE GOODS OR
 * SERVICES; LOSS OF USE, DATA, OR PROFITS; OR BUSINESS
 * INTERRUPTION) HOWEVER CAUSED AND ON ANY THEORY OF LIABILITY,
 * WHETHER IN CONTRACT, STRICT LIABILITY, OR TORT (INCLUDING
 * NEGLIGENCE OR OTHERWISE) ARISING IN ANY WAY OUT OF THE USE
 * OF THIS SOFTWARE, EVEN IF ADVISED OF THE POSSIBILITY OF SUCH DAMAGE.
 */
/dts-v1/;
#include "k230.dtsi"

#ifndef BANK_VOLTAGE_IO50_IO61
#define BANK_VOLTAGE_IO50_IO61	 K230_MSC_3V3
#endif

/ {
	model = "kendryte k230d";
	compatible = "kendryte,k230d";
	#address-cells = <2>;
	#size-cells = <2>;

	memory@0 {
		device_type = "memory";
		reg = <
				0x0 0x0000000 0x0 0x8000000
			  >;
	};
};

&iomux {
	pinctrl-names = "default";
	pinctrl-0 = <&drops_pins>;

//	Please pay attention to the bank voltage! will damage the chip.
	drop_pins: drop_pins {
		u-boot,dm-pre-reloc;
		pinctrl-single,pins = <
		(IO9 ) ( 0<<SEL | 0<<SL | 0 <<MSC | 0<<IE | 0<<OE | 0<<PU | 0<<PD | 7<<DS | 1<<ST )
		(IO42) ( 0<<SEL | 0<<SL | 0<<MSC | 0<<IE | 0<<OE | 0<<PU | 0<<PD | 7<<DS | 1<<ST )
		(IO43) ( 0<<SEL | 0<<SL | 0<<MSC | 0<<IE | 0<<OE | 0<<PU | 0<<PD | 7<<DS | 1<<ST )
		(IO46) ( 0<<SEL | 0<<SL | 0<<MSC | 0<<IE | 0<<OE | 0<<PU | 0<<PD | 7<<DS | 1<<ST )
		(IO47) ( 0<<SEL | 0<<SL | 0<<MSC | 0<<IE | 0<<OE | 0<<PU | 0<<PD | 7<<DS | 1<<ST )
		(IO50) ( 0<<SEL | 0<<SL | BANK_VOLTAGE_IO50_IO61<<MSC | 0<<IE | 0<<OE | 0<<PU | 0<<PD | 7<<DS | 1<<ST )
		(IO51) ( 0<<SEL | 0<<SL | BANK_VOLTAGE_IO50_IO61<<MSC | 0<<IE | 0<<OE | 0<<PU | 0<<PD | 7<<DS | 1<<ST )
		(IO52) ( 0<<SEL | 0<<SL | BANK_VOLTAGE_IO50_IO61<<MSC | 0<<IE | 0<<OE | 0<<PU | 0<<PD | 7<<DS | 1<<ST )
		(IO53) ( 0<<SEL | 0<<SL | BANK_VOLTAGE_IO50_IO61<<MSC | 0<<IE | 0<<OE | 0<<PU | 0<<PD | 7<<DS | 1<<ST )
		(IO54) ( 0<<SEL | 0<<SL | BANK_VOLTAGE_IO50_IO61<<MSC | 0<<IE | 0<<OE | 0<<PU | 0<<PD | 7<<DS | 1<<ST )
		(IO55) ( 0<<SEL | 0<<SL | BANK_VOLTAGE_IO50_IO61<<MSC | 0<<IE | 0<<OE | 0<<PU | 0<<PD | 7<<DS | 1<<ST )
		(IO56) ( 0<<SEL | 0<<SL | BANK_VOLTAGE_IO50_IO61<<MSC | 0<<IE | 0<<OE | 0<<PU | 0<<PD | 7<<DS | 1<<ST )
		(IO57) ( 0<<SEL | 0<<SL | BANK_VOLTAGE_IO50_IO61<<MSC | 0<<IE | 0<<OE | 0<<PU | 0<<PD | 7<<DS | 1<<ST )
		(IO58) ( 0<<SEL | 0<<SL | BANK_VOLTAGE_IO50_IO61<<MSC | 0<<IE | 0<<OE | 0<<PU | 0<<PD | 7<<DS | 1<<ST )
		>;
	};
};
